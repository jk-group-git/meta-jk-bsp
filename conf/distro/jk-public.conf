## conf/distro/jk-public.conf
```bitbake
require conf/distro/poky.conf

DISTRO_FEATURES="acl argp ext2 largefile usbhost xattr pci ipv4 ipv6 libc-backtrace libc-big-macros libc-bsd libc-cxx-tests libc-catgets libc-charsets libc-crypt libc-crypt-ufc libc-db-aliases libc-envz libc-fcvt libc-fmtmsg libc-fstab libc-ftraverse libc-getlogin libc-idn libc-inet-anl libc-libm libc-locales libc-locale-code libc-memusage libc-nis libc-nsswitch libc-rcmd libc-rtld-debug libc-spawn libc-streams libc-sunrpc libc-utmp libc-utmpx libc-wordexp libc-posix-clang-wchar libc-posix-regexp libc-posix-regexp-glibc libc-posix-wchar-io largefile ptest multiarch gobject-introspection-data ldconfig systemd journald gstreamer bluetooth bluez bluez5 wifi"

VIRTUAL-RUNTIME_base-utils = ""
VIRTUAL-RUNTIME_login_manager = "shadow"

PNBLACKLIST[busybox] = "having proper tools is not worth saving 20MiB"

DISTRO_FEATURES_REMOVE = " wayland x11 directfb "
DISTRO_FEATURES_BACKFILL_CONSIDERED = " sysvinit x11 wayland "
VIRTUAL-RUNTIME_init_manager = "systemd"

PACKAGECONFIG_append_pn-qemu-native = " sdl"
PACKAGECONFIG_append_pn-nativesdk-qemu = " sdl"

PACKAGECONFIG_append_pn-qtbase = " accessibility libs eglfs opengl dbus harfbuzz evdev kms udev journald release tools glib jpeg gif gl freetype fontconfig glib"
PACKAGECONFIG_append_pn-mesa = " dri opengl eglfs vulkan gles egl gallium imx etnaviv gbm "
PACKAGECONFIG_append_pn-cairo = " egl glesv2 "
PACKAGECONFIG_append_pn-gdk-pixbuf = " png jpeg tiff jpeg2000 "

PACKAGECONFIG_remove_pn-networkmanager = "dnsmasq"

PACKAGECONFIG_remove_pn-systemd = "hostnamed"

IMAGE_INSTALL_append = " tar "

DISTRO_FEATURES_append =" egl eglfs opengl alsa"

PACKAGECONFIG_append_pn-qtbase = " accessibility eglfs hwcodecs "

PACKAGECONFIG_append_pn-qtmultimedia = " gstreamer "

PACKAGECONFIG_remove_pn-mesa = " vulkan "

PACKAGECONFIG_remove_pn-systemd = " timesyncd "

PREFERRED_PROVIDER_virtual/egl = "imx-gpu-viv"
PREFERRED_PROVIDER_virtual/libgles1 = "imx-gpu-viv"
PREFERRED_PROVIDER_virtual/libgles2= "imx-gpu-viv"
PREFERRED_PROVIDER_virtual/libgl = "imx-gpu-viv"
PREFERRED_PROVIDER_virtual/libg2d = "imx-gpu-viv"

INHERIT += "archiver"
ARCHIVER_MODE[srpm] = "1"
COPY_LIC_MANIFEST = "1"
COPY_LIC_DIRS = "1"
LICENSE_CREATE_PACKAGE = "1"
FILES_${PN}_append = " ${datadir}/licenses/${PN}"
FILES_${PN}_append = " ${datadir}/${PN}/licenses/"
COPYLEFT_LICENSE_EXCLUDE += "CLOSED"
COPYLEFT_LICENSE_EXCLUDE += "Closed"
COPYLEFT_LICENSE_EXCLUDE += "closed"
COPYLEFT_LICENSE_EXCLUDE += "Proprietary"
COPYLEFT_LICENSE_EXCLUDE += "proprietary"
```

## conf/layer.conf
```bitbake
# We have a conf and classes directory, append to BBPATH
BBPATH .= ":${LAYERDIR}"

# We have a recipes directory containing .bb and .bbappend files, add to BBFILES
BBFILES += "${LAYERDIR}/recipes*/*/*.bb \
            ${LAYERDIR}/recipes*/*/*.bbappend"

BBFILE_COLLECTIONS += "meta-jk-bsp"
BBFILE_PATTERN_meta-jk-bsp := "^${LAYERDIR}/"
BBFILE_PRIORITY_meta-jk-bsp = "9"


#The dynamic-layers directory hosts the extensions and layer specific
# modifications related to Freescale products.
#
# The .bbappend and .bb files are included if the respective layer
# collection is available.
BBFILES += "${@' '.join('${LAYERDIR}/dynamic-layers/%s/recipes*/*/*.bbappend' % layer \
        for layer in BBFILE_COLLECTIONS.split())}"
BBFILES += "${@' '.join('${LAYERDIR}/dynamic-layers/%s/recipes*/*/*.bb' % layer \
        for layer in BBFILE_COLLECTIONS.split())}"
```
